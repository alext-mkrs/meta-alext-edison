## conf/layer.conf
```bitbake
# We have a conf and classes directory, add to BBPATH
BBPATH .= ":${LAYERDIR}"

# We have a recipes directory, add to BBFILES
BBFILES += "${LAYERDIR}/recipes-*/*/*.bb \
	    ${LAYERDIR}/recipes-*/*/*.bbappend"

BBFILE_COLLECTIONS += "alext-edison"
BBFILE_PATTERN_alext-edison:= "^${LAYERDIR}/"
BBFILE_PRIORITY_alext-edison = "9"
```
